## compat/dunfell/conf/layer.conf
```bitbake
# The line bellow includes recipes to BBFILES only if exists a subdirectory
# under 'compat' who matches with LAYERSERIES_CORENAMES (Yocto release you're using).
BBFILES += "${LAYERDIR}/compat/${LAYERSERIES_CORENAMES}/*/*/*.bb \
"

# The shellhub-agent requires Go 1.20+
GOVERSION = "1.22%"
export GOPROXY ??= "https://proxy.golang.org,direct"
PREFERRED_PROVIDER_go-native = "go-binary-native"
PREFERRED_VERSION_go-binary-native = "${GOVERSION}"
```
